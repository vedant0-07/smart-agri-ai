/*
 * main.c  —  Smart Agriculture AI TFT Display
 * Target: MicroBlaze on 3EDGE Artix-7 XC7A35T
 * IDE:    Vitis 2022/2023
 *
 * Flow:
 *   ESP32 (WiFi) --UART 115200--> MicroBlaze --SPI--> ILI9341 TFT
 *
 * Protocol (from ESP32):
 *   0xBB [len] [label ASCII...] [conf_percent 0-100] 0xCC
 */

#include <stdio.h>
#include <string.h>
#include <stdint.h>
#include "xparameters.h"
#include "xuartlite.h"
#include "xgpio.h"
#include "xspi.h"
#include "sleep.h"

/* ─── Peripheral IDs (from xparameters.h) ─────────────────── */
#define UART_DEVICE_ID     XPAR_AXI_UART_ESP32_DEVICE_ID
#define SPI_DEVICE_ID      XPAR_AXI_SPI_TFT_DEVICE_ID
#define GPIO_DEVICE_ID     XPAR_AXI_GPIO_TFT_DEVICE_ID

/* ─── GPIO bit assignments ─────────────────────────────────── */
#define TFT_DC_BIT   0x01   /* tft_ctrl[0] = DC */
#define TFT_RST_BIT  0x02   /* tft_ctrl[1] = RST */

/* ─── ILI9341 Colors (RGB565) ─────────────────────────────── */
#define C_BLACK  0x0000
#define C_WHITE  0xFFFF
#define C_BG     0x0841   /* Dark navy background */
#define C_HDR    0x0260   /* Dark green header */
#define C_SEP    0x07E0   /* Bright green separator */
#define C_GRAY   0x8410   /* Gray for subtitles */
#define C_YELO   0xFFE0   /* Yellow for confidence */
#define C_BBAR   0x18A3   /* Dark bar background */
#define C_BFIL   0x07E0   /* Green bar fill */

/* ─── 8×8 Font (ASCII 0x20 to 0x7E) ──────────────────────── */
/* Each char = 8 bytes, one byte per row, MSB = leftmost pixel */
static const uint8_t font8x8[96][8] = {
    {0x00,0x00,0x00,0x00,0x00,0x00,0x00,0x00}, /* 0x20 space */
    {0x18,0x3C,0x3C,0x18,0x18,0x00,0x18,0x00}, /* 0x21 ! */
    {0x36,0x36,0x00,0x00,0x00,0x00,0x00,0x00}, /* 0x22 " */
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    {0x6E,0x3B,0x00,0x00,0x00,0x00,0x00,0x00}, /* 0x7E ~ */
};

/* ─── Peripheral instances ─────────────────────────────────── */
static XUartLite uart;
static XGpio     gpio;
static XSpi      spi;

/* ─── GPIO macros ──────────────────────────────────────────── */
static uint32_t gpio_val = 0;

static void gpio_set(uint32_t mask)  {
    gpio_val |=  mask;
    XGpio_DiscreteWrite(&gpio, 1, gpio_val);
}
static void gpio_clr(uint32_t mask)  {
    gpio_val &= ~mask;
    XGpio_DiscreteWrite(&gpio, 1, gpio_val);
}

#define DC_CMD()  gpio_clr(TFT_DC_BIT)
#define DC_DAT()  gpio_set(TFT_DC_BIT)
#define RST_LO()  gpio_clr(TFT_RST_BIT)
#define RST_HI()  gpio_set(TFT_RST_BIT)

/* ─── SPI send byte ────────────────────────────────────────── */
static void spi_send(uint8_t byte) {
    uint8_t buf[1] = { byte };
    XSpi_Transfer(&spi, buf, NULL, 1);
}

/* ─── ILI9341 command/data ─────────────────────────────────── */
static void tft_cmd(uint8_t cmd) {
    DC_CMD();
    spi_send(cmd);
}

static void tft_dat(uint8_t dat) {
    DC_DAT();
    spi_send(dat);
}

static void tft_dat16(uint16_t val) {
    DC_DAT();
    spi_send(val >> 8);
    spi_send(val & 0xFF);
}

/* ─── Set pixel window ─────────────────────────────────────── */
static void tft_set_window(uint16_t x1, uint16_t y1,
                            uint16_t x2, uint16_t y2) {
    tft_cmd(0x2A);
    tft_dat(x1 >> 8); tft_dat(x1 & 0xFF);
    tft_dat(x2 >> 8); tft_dat(x2 & 0xFF);

    tft_cmd(0x2B);
    tft_dat(y1 >> 8); tft_dat(y1 & 0xFF);
    tft_dat(y2 >> 8); tft_dat(y2 & 0xFF);

    tft_cmd(0x2C);
    DC_DAT();
}

/* ─── Fill rectangle with solid color ─────────────────────── */
static void tft_fill_rect(uint16_t x, uint16_t y,
                           uint16_t w, uint16_t h,
                           uint16_t color) {
    tft_set_window(x, y, x + w - 1, y + h - 1);
    uint32_t n = (uint32_t)w * h;
    while (n--) tft_dat16(color);
}

/* ─── Draw one character (scale 1× or 2×) ─────────────────── */
static void tft_draw_char(uint16_t x, uint16_t y,
                           char c,
                           uint16_t fg, uint16_t bg,
                           uint8_t scale) {
    if (c < 0x20 || c > 0x7E) c = 0x20;
    const uint8_t *bmap = font8x8[c - 0x20];
    uint16_t cw = 8 * scale;
    uint16_t ch = 8 * scale;

    tft_set_window(x, y, x + cw - 1, y + ch - 1);

    for (int row = 0; row < 8; row++) {
        for (int sr = 0; sr < scale; sr++) {
            for (int col = 0; col < 8; col++) {
                uint16_t color = (bmap[row] & (0x80 >> col)) ? fg : bg;
                for (int sc = 0; sc < scale; sc++) {
                    tft_dat16(color);
                }
            }
        }
    }
}

/* ─── Draw string (scale 1× or 2×) ─────────────────────────── */
static void tft_draw_str(uint16_t x, uint16_t y,
                          const char *s,
                          uint16_t fg, uint16_t bg,
                          uint8_t scale) {
    while (*s) {
        tft_draw_char(x, y, *s++, fg, bg, scale);
        x += 8 * scale;
        if (x + 8 * scale > 240) break;
    }
}

/* ─── ILI9341 initialization sequence ─────────────────────── */
static void tft_init(void) {
    /* Hardware reset */
    RST_LO(); usleep(20000);
    RST_HI(); usleep(150000);

    tft_cmd(0x01); usleep(150000); /* SWRESET */
    tft_cmd(0x11); usleep(255000); /* SLPOUT  */

    tft_cmd(0x3A); tft_dat(0x55); /* COLMOD: 16-bit color */
    tft_cmd(0x36); tft_dat(0x48); /* MADCTL: portrait, BGR */

    /* Display area */
    tft_cmd(0x2A);
    tft_dat(0x00); tft_dat(0x00);
    tft_dat(0x00); tft_dat(0xEF); /* 240 */

    tft_cmd(0x2B);
    tft_dat(0x00); tft_dat(0x00);
    tft_dat(0x01); tft_dat(0x3F); /* 320 */

    tft_cmd(0x13);                /* NORON  */
    tft_cmd(0x20);                /* INVOFF */
    tft_cmd(0x29); usleep(25000); /* DISPON */

    /* Clear to background */
    tft_fill_rect(0, 0, 240, 320, C_BG);
}

/* ─── Draw static UI (called once at startup) ──────────────── */
static void draw_static_ui(void) {
    /* Header bar */
    tft_fill_rect(0, 0, 240, 32, C_HDR);
    /* Separator */
    tft_fill_rect(0, 32, 240, 2, C_SEP);

    /* Header text */
    tft_draw_str(4, 10, "AI SMART AGRI", C_WHITE, C_HDR, 1);

    /* Section labels */
    tft_draw_str(4, 42, "DETECTED:", C_GRAY, C_BG, 1);
    tft_draw_str(4, 100, "CONFIDENCE:", C_GRAY, C_BG, 1);

    /* Footer */
    tft_fill_rect(0, 300, 240, 20, 0x0420);
    tft_draw_str(30, 306, "TinyML Smart Agri", C_GRAY, 0x0420, 1);

    /* Waiting message */
    tft_draw_str(20, 160, "Waiting for result...", C_GRAY, C_BG, 1);
}

/* ─── Draw AI result on TFT ─────────────────────────────────── */
static void draw_result(const char *label, uint8_t conf_pct) {
    char conf_str[8];

    /* Format confidence string: "87%" */
    if (conf_pct >= 100)
        snprintf(conf_str, sizeof(conf_str), "100%%");
    else if (conf_pct >= 10)
        snprintf(conf_str, sizeof(conf_str), " %d%%", conf_pct);
    else
        snprintf(conf_str, sizeof(conf_str), "  %d%%", conf_pct);

    /* ── Clear result areas ───────────────────────────────── */
    tft_fill_rect(0, 55,  240, 36, C_BG);   /* label area   */
    tft_fill_rect(0, 113, 240, 36, C_BG);   /* conf area    */
    tft_fill_rect(0, 154, 240, 14, C_BBAR); /* bar area     */
    tft_fill_rect(0, 170, 240, 10, C_BG);   /* below bar    */

    /* ── Draw label (2× scale, white) ────────────────────── */
    tft_draw_str(4, 58, label, C_WHITE, C_BG, 2);

    /* ── Draw confidence value (2× scale, yellow) ────────── */
    tft_draw_str(4, 116, conf_str, C_YELO, C_BG, 2);

    /* ── Draw confidence bar ─────────────────────────────── */
    uint16_t bar_w = (uint16_t)((uint32_t)conf_pct * 230 / 100);
    /* Bar background (full width) */
    tft_fill_rect(4, 154, 230, 14, C_BBAR);
    /* Bar fill (proportional) */
    if (bar_w > 0)
        tft_fill_rect(4, 154, bar_w, 14, C_BFIL);

    /* LED indicator via GPIO2 */
    XGpio_DiscreteWrite(&gpio, 2,
        (conf_pct > 75) ? 0x0F :
        (conf_pct > 50) ? 0x07 :
        (conf_pct > 25) ? 0x03 : 0x01);
}

/* ─── UART result parser ─────────────────────────────────────
 * Protocol: 0xBB [len] [label bytes] [conf%] 0xCC
 * Returns 1 if a complete result was parsed
 */
#define PROTO_START 0xBB
#define PROTO_END   0xCC
#define MAX_LABEL   20

static char   last_label[MAX_LABEL + 1];
static uint8_t last_conf;

typedef enum {
    PS_IDLE = 0,
    PS_LEN,
    PS_LABEL,
    PS_CONF,
    PS_END
} ParseState;

static int parse_uart(void) {
    static ParseState  state    = PS_IDLE;
    static uint8_t     rx_label[MAX_LABEL];
    static uint8_t     label_len = 0;
    static uint8_t     char_cnt  = 0;
    static uint8_t     rx_conf   = 0;
    uint8_t byte;
    int got_result = 0;

    /* Drain all available bytes */
    while (XUartLite_Recv(&uart, &byte, 1) == 1) {
        switch (state) {
        case PS_IDLE:
            if (byte == PROTO_START) {
                memset(rx_label, ' ', MAX_LABEL);
                char_cnt  = 0;
                label_len = 0;
                state     = PS_LEN;
            }
            break;

        case PS_LEN:
            label_len = (byte > MAX_LABEL) ? MAX_LABEL : byte;
            state     = PS_LABEL;
            break;

        case PS_LABEL:
            if (char_cnt < label_len && char_cnt < MAX_LABEL)
                rx_label[char_cnt] = byte;
            char_cnt++;
            if (char_cnt >= label_len)
                state = PS_CONF;
            break;

        case PS_CONF:
            rx_conf = byte;
            state   = PS_END;
            break;

        case PS_END:
            if (byte == PROTO_END) {
                /* Copy result */
                memcpy(last_label, rx_label, MAX_LABEL);
                last_label[MAX_LABEL] = '\0';
                /* Trim trailing spaces */
                for (int i = MAX_LABEL - 1; i >= 0 && last_label[i] == ' '; i--)
                    last_label[i] = '\0';
                last_conf  = rx_conf;
                got_result = 1;
            }
            state = PS_IDLE;
            break;
        }
    }
    return got_result;
}

/* ─── Main ─────────────────────────────────────────────────── */
int main(void) {
    xil_printf("\r\n===================================\r\n");
    xil_printf("  Smart Agriculture AI TFT Display\r\n");
    xil_printf("  MicroBlaze on 3EDGE Artix-7\r\n");
    xil_printf("===================================\r\n");

    /* ── Init UART (ESP32) ─────────────────────────────────── */
    XUartLite_Initialize(&uart, UART_DEVICE_ID);
    XUartLite_ResetFifos(&uart);
    xil_printf("UART ready (115200 baud)\r\n");

    /* ── Init GPIO ─────────────────────────────────────────── */
    XGpio_Initialize(&gpio, GPIO_DEVICE_ID);
    XGpio_SetDataDirection(&gpio, 1, 0x00);  /* Channel 1 = outputs (TFT ctrl) */
    XGpio_SetDataDirection(&gpio, 2, 0x00);  /* Channel 2 = outputs (LEDs) */
    gpio_val = 0;
    RST_HI(); DC_DAT();

    /* ── Init SPI ─────────────────────────────────────────── */
    XSpi_Config *spi_cfg = XSpi_LookupConfig(SPI_DEVICE_ID);
    XSpi_CfgInitialize(&spi, spi_cfg, spi_cfg->BaseAddress);
    XSpi_SetOptions(&spi,
        XSP_MASTER_OPTION |
        XSP_CLK_ACTIVE_LOW_OPTION |  /* CPOL=0 */
        XSP_CLK_PHASE_1_OPTION |     /* CPHA=0 */
        XSP_MANUAL_SSELECT_OPTION);
    XSpi_SetSlaveSelect(&spi, 0x01);
    XSpi_Start(&spi);
    XSpi_IntrGlobalDisable(&spi);
    xil_printf("SPI ready\r\n");

    /* ── Init ILI9341 TFT ─────────────────────────────────── */
    xil_printf("Initializing TFT display...\r\n");
    tft_init();
    draw_static_ui();
    xil_printf("TFT ready!\r\n");

    /* LED: idle = 1 LED on */
    XGpio_DiscreteWrite(&gpio, 2, 0x01);

    xil_printf("Waiting for AI results from ESP32...\r\n");
    xil_printf("(ESP32 should POST to /result endpoint)\r\n\r\n");

    /* ── Main loop ─────────────────────────────────────────── */
    while (1) {
        if (parse_uart()) {
            xil_printf("Result: [%s] %d%%\r\n", last_label, last_conf);
            draw_result(last_label, last_conf);
        }

        /* Small delay to avoid CPU spin */
        usleep(1000);
    }

    return 0;
}
